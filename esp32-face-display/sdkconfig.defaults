## esp32-face-display/sdkconfig.defaults
```kconfig
# Target: ESP32-S3
CONFIG_IDF_TARGET="esp32s3"

# TinyUSB for composite device (CDC + UAC) — replaces USB Serial/JTAG console
CONFIG_TINYUSB_CDC_ENABLED=y

# Logging (routed through TinyUSB CDC)
CONFIG_LOG_DEFAULT_LEVEL_INFO=y

# FreeRTOS: both cores enabled
CONFIG_FREERTOS_UNICORE=n

# Task watchdog
CONFIG_ESP_TASK_WDT_EN=y
CONFIG_ESP_TASK_WDT_TIMEOUT_S=5

# PSRAM (FNK0104 has 8MB octal PSRAM)
CONFIG_SPIRAM=y
CONFIG_SPIRAM_MODE_OCT=y
CONFIG_SPIRAM_SPEED_80M=y
CONFIG_SPIRAM_USE_CAPS_ALLOC=y
```

## esp32-reflex/sdkconfig.defaults
```kconfig
# Target: ESP32-S3
CONFIG_IDF_TARGET="esp32s3"

# Console over native USB CDC — TinyUSB composite device with proper cdc_acm
# Linux driver.  Secondary console disabled to prevent text leaking into the
# USB Serial/JTAG binary protocol stream.
CONFIG_ESP_CONSOLE_USB_CDC=y
CONFIG_ESP_CONSOLE_SECONDARY_NONE=y
CONFIG_BOOTLOADER_LOG_LEVEL_NONE=y

# Logging (compile-time level; runtime suppressed via esp_log_level_set in app_main)
CONFIG_LOG_DEFAULT_LEVEL_INFO=y

# FreeRTOS
CONFIG_FREERTOS_UNICORE=n
CONFIG_FREERTOS_HZ=1000

# Task watchdog — we'll register control_task with it
CONFIG_ESP_TASK_WDT_EN=y
CONFIG_ESP_TASK_WDT_TIMEOUT_S=3
```
